## app/Kconfig
```kconfig
#Tha applicaton Kconfig file
#
#
#
#rs485d

config ENABLE_APP_RS485D
    bool "Enable rs485d"
    default y
    help
        compile rs485d

#menu "rs485d"
#depends on ENABLE_APP_RS485D
#source app/rs485d/Kconfig
#endmenu


config  ENABLE_APP_RS485C
    bool "Enable rs485c"
    help
        compile rs485c

menu "rs485c"
depends on ENABLE_APP_RS485C
source app/rs485c/Kconfig
endmenu
```

## app/rs485c/Kconfig
```kconfig
#This Config for rs485 client

choice
    prompt "Protocol test"
    default RS485C_PROTOCOL_GENERAL

config RS485C_PROTOCOL_BACNET
    bool "BACnet"
    help
        The client test type used BACnet

config RS485C_PROTOCOL_GENERAL
    bool "General"
    help
        The client test type used General

config RS485C_PROTOCOL_MODBUS
    bool "Modbus"
    help
        The client test type used Modbus

endchoice
```

## app/rs485d/Kconfig
```kconfig
#######################################
#The rs485d config

#######################################
#The debug option
choice
    prompt "App Debug"
    default APP_DEBUG_TO_LINUX_SYSLOG

config APP_DEBUG_DISABLE
    bool "App debug disable"
    help
        Havn't used Debug

config APP_DEBUG_TO_LINUX_SYSLOG
    bool "App debug to syslog"
    help
        write log message to syslog, you can used 'cat /var/log/messages'

config APP_DEBUG_TO_TERMINAL
    bool "App debug to terminal"
    help
        write log message to terminal.

endchoice

######################################
#The item config
choice
    prompt "Item config type"
    default NEW_ITEM_CONFIG

config OLD_ITEM_CONFIG
    bool "Old item config"
    help
        used the old item config by item, for example: default, daikin

config NEW_ITEM_CONFIG
    bool "New item config"
    help
        used the item config by KNX ETS

endchoice


choice
    prompt "Item"
    default OLD_ITME_CONFIG_DEFAULT
    depends on OLD_ITEM_CONFIG

config OLD_ITEM_CONFIG_DEFAULT
    bool "Default"
    help
        The old item config default

config OLD_ITEM_CONFIG_AIR_CONDITION_YORK_KELONG
    bool "Air: York Kelong"
    help
        The York kelong air conditon, by BACnet protocol

config OLD_ITEM_CONFIG_AIR_CONDITION_DAIKIN_DTA116A621
    bool "Air: DAIKIN DTA116A621"
    help
        The DaiKin air condition adapter, by modbus protocol

config OLD_ITEM_CONFIG_AIR_CONDITION_HITACHI_VRV_MANAGER
    bool "Air: Hitachi VRV Manager"
    help
        The Hitachi VRV Manager adapter, by modbus protocol

config OLD_ITEM_CONFIG_AIR_CONDITION_YORK_JOHNSON
    bool "Air: York Johnson control"
    help
        The York Johnson control air condition adapter, by modbus protocol

endchoice
```

## sdk/config/Kconfig
```kconfig
mainmenu "Project build Configuration"

###########################################
#The application
menu "App"
source app/Kconfig
endmenu


############################################
#The sdk modules
menu "Modules"
endmenu


############################################
#The miscellaneous
menu "Miscellaneous"
endmenu


###########################################
#The Debuging
menu "Development and Debugging"

config ENABLE_ERROR_LOGS
       bool
       prompt "Enable error logs"
       default y
       help
		If you enable this, error messages
		will be printed in case of error
		conditions. This will increase the
		size of the image. It is strongly
		recommended to keep it enabled
		during development, to quickly
		localize problems.

config ENABLE_WARNING_LOGS
       bool
       prompt "Enable warning logs"
       default y
       help
		If you enable this, error messages
		will be printed in case of error
		conditions. This will increase the
		size of the image. It is strongly
		recommended to keep it enabled
		during development, to quickly
		localize problems.

config DEBUG_BUILD
       bool
       prompt  "Debug build"
       default y
       help
		If you enable this the debug options will be
      		 enabled. Asserts will be also be enabled.
      		 
endmenu
```

## sdk/framework/Kconfig
```kconfig
##########################
#This config the frame



##########################
#config bus
config ENABLE_FRAME_BUS
    bool "Enable framework bus"
    select ENABLE_MODULE_WLIST
    help
        The bus framework support
```

## sdk/module/Kconfig
```kconfig
##########################
#This config the module

#####################################
#config daemon
config ENABLE_MODULE_DAEMON
    bool "Enable daemon"
    help
        The daemon module enable

####################################
#config message queue
config ENABLE_MODULE_MESSAGE_QUEUE
    bool "Enable message_queue"
    help
        The message_queue module enable

####################################
#config ringbuffer
config ENABLE_MODULE_RINGBUFFER
    bool "Enable ringbuffer"
    help
        The ringbuffer module enable

###################################
#config list
config ENABLE_MODULE_WLIST
    bool "Enable list"
    help
        The wlist module enable


#####################################
#config timer
config ENABLE_MODULE_TIMER
    bool "Enable timer"
    help
        The timer module enable

menu "timer"
    depends on ENABLE_MODULE_TIMER

choice
    prompt "Timer percision"
    default MODULE_TIMER_PERCISION_1S

config MODULE_TIMER_PERCISION_10MS
    bool "10 ms"
    help
        The percision is 10ms

config MODULE_TIMER_PERCISION_50MS
    bool "50 ms"
    help
        The percision is 50ms

config MODULE_TIMER_PERCISION_100MS
    bool "100 ms"
    help
        The percision is 100ms

config MODULE_TIMER_PERCISION_500MS
    bool "500 ms"
    help
        The percision is 500ms

config MODULE_TIMER_PERCISION_1S
    bool "1 second"
    help
        The percision is 1 second

config MODULE_TIMER_PERCISION_10S
    bool "10 second"
    help
        The percision is 10 second
endchoice


choice
    prompt "Tick type"

config MODULE_TIMER_TICK_TYPE_SLEEP
    depends on (MODULE_TIMER_PERCISION_1S || MODULE_TIMER_PERCISION_10S)
    bool "Sleep"
    help
        The tick is used system call sleep() function

config MODULE_TIMER_TICK_TYPE_SELECT
    bool "Select"
    help
        The tick is used system call select() function
endchoice

endmenu
```
